## drivers/misc/mediatek/sensors-1.0/hall/Kconfig
```kconfig
config CUSTOM_MTK_KERNEL_HALL
	bool "CUSTOM_MTK_KERNEL_HALL Config"
	default n
	help
	  hall sensor for MTK pakage.
```

## drivers/misc/mediatek/syntiant_ndp120/Kconfig
```kconfig
config SYNTIANT_NDP120
    bool "Enable SYNTIANT_NDP120"
	default n
	help
	  SYNTIANT_NDP120 driver is a DSP feature.
```
